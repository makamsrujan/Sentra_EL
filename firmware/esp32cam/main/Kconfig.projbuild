## firmware/esp32cam/main/Kconfig.projbuild
```kconfig
# SENTRA ESP32-CAM configuration. Never commit sdkconfig containing Wi-Fi passwords or tokens.
menu "SENTRA ESP32-CAM Sender Configuration"

config SENTRA_CAM_WIFI_SSID
    string "Wi-Fi SSID"
    default ""

config SENTRA_CAM_WIFI_PASSWORD
    string "Wi-Fi password"
    default ""

config SENTRA_CAM_BACKEND_URL
    string "Backend origin (e.g. http://192.168.x.x:3000 or https://<host>)"
    default ""

config SENTRA_CAM_DEVICE_ID
    string "Registered ESP32-CAM device ID (must be distinct from ESP32-S3 ID)"
    default "ESP32-CAM-SENTRA-001"

config SENTRA_CAM_DEVICE_TOKEN
    string "Provisioned ESP32-CAM device token (secret; keep sdkconfig out of git)"
    default ""

config SENTRA_CAM_FRAME_INTERVAL_MS
    int "JPEG capture & upload interval (ms)"
    default 1200
    range 300 15000

config SENTRA_CAM_JPEG_QUALITY
    int "OV2640 JPEG quality (10=high quality, 63=lowest)"
    default 14
    range 8 63

choice SENTRA_CAM_FRAMESIZE
    prompt "OV2640 JPEG frame resolution"
    default SENTRA_CAM_FRAMESIZE_QVGA

config SENTRA_CAM_FRAMESIZE_QVGA
    bool "QVGA (320x240) - recommended for first bench bring-up"

config SENTRA_CAM_FRAMESIZE_VGA
    bool "VGA (640x480) - higher detail (requires stable Wi-Fi & PSRAM)"

endchoice

config SENTRA_CAM_XCLK_HZ
    int "OV2640 XCLK frequency in Hz (20 MHz default for onboard AI-Thinker ribbon)"
    default 20000000
    range 10000000 20000000

config SENTRA_CAM_MAX_UPLOAD_RETRIES
    int "Maximum bounded retries per JPEG upload failure"
    default 3
    range 1 5

config SENTRA_CAM_ENABLE_FLASH_LED
    bool "Allow AI-Thinker GPIO 4 flash LED (keep disabled to avoid glare/power spikes)"
    default n

endmenu
```

## firmware/esp32s3/main/Kconfig.projbuild
```kconfig
# SENTRA device configuration. Never commit sdkconfig files containing secrets.
menu "SENTRA firmware configuration"

config SENTRA_FIRMWARE_VERSION
    string "Firmware version string"
    default "1.3.0-hw-bringup"

config SENTRA_WIFI_SSID
    string "Wi-Fi SSID"
    default ""

config SENTRA_WIFI_PASSWORD
    string "Wi-Fi password"
    default ""

config SENTRA_BACKEND_URL
    string "Backend origin (e.g. http://192.168.x.x:3000 or https://<host>)"
    default ""

config SENTRA_DEVICE_ID
    string "Registered ESP32-S3 sensor controller device ID"
    default "ESP32-S3-SENTRA-001"

config SENTRA_DEVICE_TOKEN
    string "Provisioned ESP32-S3 device token (secret; keep sdkconfig out of git)"
    default ""

menu "Step 1: S3 Bench Sensors (VL53L0X + GY-521 MPU6050)"

config SENTRA_ENABLE_VL53L0X
    bool "Enable single forward VL53L0X ToF distance sensor (0x29)"
    default y
    help
        Actual hardware has ONE forward VL53L0X. No downward ToF sensor exists.

config SENTRA_VL53L0X_ADDR
    hex "Forward VL53L0X 7-bit I2C address"
    default 0x29
    range 0x29 0x3F

config SENTRA_ENABLE_MPU6050
    bool "Enable GY-521 MPU6050 6-axis IMU (0x68, AD0 low)"
    default y

config SENTRA_PIN_I2C_SDA
    int "Shared I2C SDA GPIO (bench default: 4)"
    default 4

config SENTRA_PIN_I2C_SCL
    int "Shared I2C SCL GPIO (bench default: 40)"
    default 40

config SENTRA_I2C_FREQ_HZ
    int "Shared I2C bus clock in Hz (100000 conservative for bench/harness)"
    default 100000
    range 50000 400000

config SENTRA_PIN_VL53L0X_FWD_XSHUT
    int "Forward VL53L0X XSHUT GPIO (-1 ONLY if breakout has confirmed onboard pull-up)"
    default -1
    help
        Use -1 only on a single-sensor breakout whose XSHUT pin has a confirmed
        onboard pull-up resistor. Do not drive an unverified XSHUT pin.

config SENTRA_PIN_ACTION_BUTTON
    int "User action / PTT GPIO (-1 to disable)"
    default 5

config SENTRA_ENABLE_BATTERY_ADC
    bool "Enable ESP32-S3 ADC1 battery voltage monitor (requires external voltage divider <= 3.3V)"
    default y
    help
        Reads battery voltage via an ESP32-S3 ADC1 GPIO (GPIO 1..10, Wi-Fi safe).
        NEVER connect >3.3V directly to an ESP32-S3 pin; use an external resistor divider
        (e.g., 100 kOhm / 100 kOhm = 2000 milliratio). Unwired pins (<0.25V) report null.

config SENTRA_PIN_BATTERY_ADC
    int "Battery voltage ADC1 GPIO (default: 6 = ADC1_CH5; valid ADC1 range: 1..10)"
    depends on SENTRA_ENABLE_BATTERY_ADC
    default 6
    range 1 10

config SENTRA_BATTERY_ADC_SCALE_MILLI
    int "Battery voltage divider multiplier x1000 (e.g., 2000 for 100k/100k 2:1 divider)"
    depends on SENTRA_ENABLE_BATTERY_ADC
    default 2000
    range 1000 10000

endmenu

menu "Step 4: Optional Discrete I2S Audio (INMP441 + MAX98357A, Disabled by Default)"

config SENTRA_ENABLE_AUDIO_I2S_DISCRETE
    bool "Enable separate discrete I2S audio profile (INMP441 mic / MAX98357A amp; NO WM8960)"
    default n
    help
        Disabled by default. Phone/browser audio remains the fallback.
        Leave the speaker physically disconnected until impedance and wattage are confirmed.

config SENTRA_ENABLE_INMP441_MIC
    bool "Enable INMP441 I2S RX microphone capture (I2S_NUM_0)"
    depends on SENTRA_ENABLE_AUDIO_I2S_DISCRETE
    default n

config SENTRA_ENABLE_MAX98357A_AMP
    bool "Enable MAX98357A I2S TX mono playback (I2S_NUM_1; verify speaker rating first)"
    depends on SENTRA_ENABLE_AUDIO_I2S_DISCRETE
    default n

config SENTRA_PIN_INMP441_SCK
    int "INMP441 SCK / BCLK GPIO"
    depends on SENTRA_ENABLE_AUDIO_I2S_DISCRETE
    default 14

config SENTRA_PIN_INMP441_WS
    int "INMP441 WS / LRCLK GPIO"
    depends on SENTRA_ENABLE_AUDIO_I2S_DISCRETE
    default 15

config SENTRA_PIN_INMP441_SD
    int "INMP441 SD / DIN GPIO"
    depends on SENTRA_ENABLE_AUDIO_I2S_DISCRETE
    default 16

config SENTRA_PIN_MAX98357A_BCLK
    int "MAX98357A BCLK GPIO"
    depends on SENTRA_ENABLE_AUDIO_I2S_DISCRETE
    default 17

config SENTRA_PIN_MAX98357A_LRC
    int "MAX98357A LRC / WS GPIO"
    depends on SENTRA_ENABLE_AUDIO_I2S_DISCRETE
    default 18

config SENTRA_PIN_MAX98357A_DIN
    int "MAX98357A DIN (ESP32 DOUT) GPIO"
    depends on SENTRA_ENABLE_AUDIO_I2S_DISCRETE
    default 21

config SENTRA_AUDIO_BENCH_TEST_MIC
    bool "Run one-shot INMP441 mic capture RMS bench check on boot"
    depends on SENTRA_ENABLE_INMP441_MIC
    default n

config SENTRA_AUDIO_BENCH_TEST_TONE
    bool "Run one-shot low-amplitude MAX98357A 440 Hz tone bench check on boot"
    depends on SENTRA_ENABLE_MAX98357A_AMP
    default n

endmenu

menu "Legacy / Optional Expansion Modules (Disabled by Default)"

config SENTRA_ENABLE_CAMERA
    bool "[LEGACY] Enable direct OV2640 parallel DVP on ESP32-S3 (NOT used with separate ESP32-CAM)"
    default n

config SENTRA_CAM_SHARE_I2C_PORT
    bool "[LEGACY] Share existing I2C port 0 for direct OV2640 SCCB"
    depends on SENTRA_ENABLE_CAMERA
    default y

config SENTRA_CAM_XCLK_HZ
    int "[LEGACY] Direct OV2640 XCLK frequency in Hz"
    depends on SENTRA_ENABLE_CAMERA
    default 10000000
    range 5000000 20000000

config SENTRA_CAM_DEFAULT_QUALITY
    int "[LEGACY] Direct OV2640 JPEG quality (4=best, 63=lowest)"
    depends on SENTRA_ENABLE_CAMERA
    default 12
    range 4 63

config SENTRA_ENABLE_WM8960
    bool "[LEGACY] Enable Waveshare WM8960 I2S audio codec (NOT present on actual hardware)"
    default n

config SENTRA_PIN_I2S_BCLK
    int "[LEGACY] WM8960 I2S BCLK GPIO"
    depends on SENTRA_ENABLE_WM8960
    default 41

config SENTRA_PIN_I2S_WS
    int "[LEGACY] WM8960 I2S WS GPIO"
    depends on SENTRA_ENABLE_WM8960
    default 42

config SENTRA_PIN_I2S_DOUT
    int "[LEGACY] WM8960 I2S DOUT GPIO"
    depends on SENTRA_ENABLE_WM8960
    default 2

config SENTRA_PIN_I2S_DIN
    int "[LEGACY] WM8960 I2S DIN GPIO"
    depends on SENTRA_ENABLE_WM8960
    default 1

config SENTRA_PIN_I2S_MCLK
    int "[LEGACY] WM8960 I2S MCLK GPIO"
    depends on SENTRA_ENABLE_WM8960
    default 38

config SENTRA_ENABLE_VL53L5CX
    bool "Enable optional VL53L5CX multizone depth sensor"
    default n

endmenu

menu "Sampling Intervals & Experimental Obstruction Thresholds"

config SENTRA_TOF_SAMPLE_INTERVAL_MS
    int "VL53L0X sampling interval (ms)"
    default 250
    range 50 5000

config SENTRA_IMU_SAMPLE_INTERVAL_MS
    int "MPU6050 sampling interval (ms)"
    default 200
    range 20 5000

config SENTRA_TELEMETRY_INTERVAL_MS
    int "Telemetry / heartbeat upload interval (ms)"
    default 2000
    range 500 15000

config SENTRA_FRAME_UPLOAD_INTERVAL_MS
    int "[LEGACY] Direct S3 camera upload interval (ms)"
    default 1200
    range 300 30000

config SENTRA_PROXIMITY_CAUTION_CM
    int "Experimental forward obstruction caution threshold (cm)"
    default 100
    range 25 300

config SENTRA_PROXIMITY_CRITICAL_CM
    int "Experimental forward obstruction critical threshold (cm)"
    default 45
    range 10 150

config SENTRA_PROXIMITY_HYSTERESIS_CM
    int "Forward obstruction release hysteresis (cm)"
    default 10
    range 2 40

config SENTRA_ALERT_COOLDOWN_MS
    int "Minimum cooldown between repeated local alerts (ms)"
    default 3000
    range 500 30000

endmenu

endmenu
```
